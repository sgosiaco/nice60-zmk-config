## config/west.yml
```yaml
manifest:
  remotes:
    - name: sgosiaco
      url-base: https://github.com/sgosiaco
  projects:
    - name: zmk
      remote: sgosiaco
      revision: feature/middleCol
      import: app/west.yml
  self:
    path: config
```
